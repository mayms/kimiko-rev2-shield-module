#include "kimiko.dtsi"

&default_transform { // The matrix transform for this board is 8 columns over because the left half is 8 columns wide according to the matrix.
    col-offset = <8>;
};

&kscan0 {
    col-gpios
        = <&gpio1 11 GPIO_ACTIVE_HIGH> // Col 5 from PCB
        , <&gpio0 28 GPIO_ACTIVE_HIGH> // Col 4 from PCB
        , <&gpio0 03 GPIO_ACTIVE_HIGH> // Col 3 from PCB
        , <&gpio1 13 GPIO_ACTIVE_HIGH> // Col 2 from PCB
        , <&gpio0  2 GPIO_ACTIVE_HIGH> // Col 1 from PCB
        , <&gpio0 29 GPIO_ACTIVE_HIGH> // Col 0 from PCB
        ;
};