## boards/shields/kimiko-rev2/Kconfig.shield
```kconfig
config SHIELD_KIMIKO_LEFT
    def_bool $(shields_list_contains, kimiko_left)

config SHIELD_KIMIKO_RIGHT
    def_bool $(shields_list_contains, kimiko_right)
```

## boards/shields/kimiko_rev2/Kconfig.defconfig
```kconfig
if SHIELD_KIMIKO_LEFT

config ZMK_KEYBOARD_NAME
    default "Kimiko"

config ZMK_SPLIT_ROLE_CENTRAL
    default y

config ZMK_SPLIT
    default y

endif

if SHIELD_KIMIKO_RIGHT

config ZMK_SPLIT_ROLE_CENTRAL
    default n

config ZMK_SPLIT
    default y

endif
```

## boards/shields/kimiko_rev2/Kconfig.shield
```kconfig
config SHIELD_KIMIKO_LEFT
    def_bool $(shields_list_contains, kimiko_rev2_left)

config SHIELD_KIMIKO_RIGHT
    def_bool $(shields_list_contains, kimiko_rev2_right)
```
